/ {
    behaviors {
        macros {
        kp_dead: kp_dead {
            compatible = "zmk,behavior-macro";
            #binding-cells = <1>;
            bindings
                = <&macro_param_1to1>, <&kp MACRO_PLACEHOLDER>
                , <&macro_tap &kp SPACE>
                ;
        };
    };
    };
};