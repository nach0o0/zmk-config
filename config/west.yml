## config/west.yml
```yaml
manifest:
  remotes:
    - name: zmkfirmware
      url-base: https://github.com/zmkfirmware
    - name: englmaxi
      url-base: https://github.com/englmaxi
    - name: mctechnology17
      url-base: https://github.com/mctechnology17
    - name: zzeneg
      url-base: https://github.com/zzeneg
    - name: nach0o0
      url-base: https://github.com/nach0o0
  projects:
    - name: zmk
      remote: zmkfirmware
      revision: main
      import: app/west.yml
    - name: zmk-dongle-display
      remote: englmaxi
      revision: main
    - name: zmk-nice-oled
      remote: mctechnology17
      revision: main
    - name: zmk-dongle-display-view
      remote: mctechnology17
      revision: main
    - name: zmk-oled-adapter
      remote: mctechnology17
      revision: main
    - name: zmk-nice-view-hid
      remote: zzeneg
      revision: main
    - name: zmk-raw-hid
      remote: zzeneg
      revision: main
    - name: zmk-behavior-os-layer
      remote: nach0o0
      revision: main
  self:
    path: config
```

## dts/bindings/behaviors/zmk,behavior-os-layer.yaml
```yaml
# Copyright (c) 2020 The ZMK Contributors
# SPDX-License-Identifier: MIT

description: Custom behavior to switch layers based on OS.

compatible: "zmk,behavior-os-layer"

include: behavior-metadata.yaml

properties:
  label:
    type: string
    required: false
    deprecated: true
  "#binding-cells":
    type: int
    required: true
    const: 4

binding-cells:
  - param1
  - param2
  - param3
  - param4
```
